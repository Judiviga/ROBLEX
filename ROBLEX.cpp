#include "ROBLEX.h"

ROBLEX::ROBLEX() {
  // Anything you need when instantiating your object goes here
  pinMode(RgbPin, OUTPUT);
  pinMode(rGbPin, OUTPUT);
  pinMode(rgBPin, OUTPUT);
  Wire.begin();
  ledcSetup(0, 2000, 8);
  ledcSetup(1, 30000, 8);
  ledcSetup(2, 30000, 8);
  ledcSetup(3, 30000, 8);
  ledcSetup(4, 30000, 8);
}

void ROBLEX::RGBled(int R , int G , int B) {
  analogWrite(RgbPin, R);
  analogWrite(rGbPin, G);
  analogWrite(rgBPin, B);
}

void ROBLEX::Drive(int pwm, int chA , int chB) {
  if (pwm < 0) {

    ledcWrite(chA, -pwm);
    ledcWrite(chB, 0);
    /*
      analogWrite(chA, -pwm);
      analogWrite(chB, 255);
    */

  } else { //  forward

    ledcWrite(chA, 0);
    ledcWrite(chB, pwm);
    /*
        analogWrite(chA, 255);
        analogWrite(chB, pwm);
    */
  }
}

int * ROBLEX::GetPins(uint8_t port) {
  static int pin[2];
  if (port == 1) {
    pin[0] = pin1A;
    pin[1] = pin1B;
  }
  else if (port == 2) {
    pin[0] = pin2A;
    pin[1] = pin2B;
  }
  else if (port == 3) {
    pin[0] = pin3A;
    pin[1] = pin3B;
  }
  else if (port == 4) {
    pin[0] = pin4A;
    pin[1] = pin4B;
  }
  else if (port == 5) {
    pin[0] = pin5A;
    pin[1] = pin5B;
  } else {
    Serial.print("SetupPort error");
  }
  return pin;
}



void ROBLEX::SetupPort(uint8_t port, uint8_t mode1 , uint8_t mode2) {
  //INPUT          0
  //OUTPUT         1
  //INPUT_PULLUP   2

  int * p = ROBLEX::GetPins(port);
  pinMode(p[0], mode1);
  pinMode(p[1], mode2);
}


// 'logo roblex', 128x64px
unsigned char ROBLEX::LogoRoblex [] PROGMEM = {
  0x00, 0x00, 0x00, 0x00, 0x00, 0x00, 0x00, 0x00, 0x00, 0x00, 0x00, 0x00, 0x00, 0x00, 0x00, 0x00, 
  0x00, 0x00, 0x00, 0x00, 0x00, 0x00, 0x00, 0x00, 0x00, 0x00, 0x00, 0x00, 0x00, 0x00, 0x00, 0x00, 
  0x00, 0x00, 0x00, 0x00, 0x00, 0x00, 0x00, 0x00, 0x00, 0x00, 0x00, 0x00, 0x00, 0x00, 0x00, 0x00, 
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  0x00, 0x00, 0x00, 0x00, 0x00, 0x00, 0x00, 0x00, 0x00, 0x00, 0x00, 0x00, 0x07, 0x80, 0x00, 0x00
};



//////////encoder
/*
  long encoder = 0;

  void IRAM_ATTR ISR() {
  if (digitalRead(pin1B) == digitalRead(pin1A) ) {
    encoder = encoder - 1;
  }
  else {
    encoder = encoder + 1;
  }
  Serial.println(encoder);
  }

    attachInterrupt(pin1A, ISR, FALLING);//setup
*/
